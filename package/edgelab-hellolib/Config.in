## package/edgelab-hellolib/Config.in
```kconfig
config BR2_PACKAGE_EDGELAB_HELLOLIB
    bool "edgelab-hellolib"
    help
      Hellolib shared library example
```

## package/edgelab/Config.in
```kconfig
config BR2_PACKAGE_EDGELAB
    bool "techleef"
    depends on BR2_PACKAGE_EDGELAB_HELLOLIB
    help
      This is a hello world demo dependent on shared library
```
